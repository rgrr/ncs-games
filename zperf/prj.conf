## CMakeLists.txt
```
# SPDX-License-Identifier: Apache-2.0

cmake_minimum_required(VERSION 3.20.0)

find_package(Zephyr REQUIRED HINTS $ENV{ZEPHYR_BASE})

project(zperf)


if(CONFIG_USB_DEVICE_NETWORK_MY_ECM)
    message(STATUS "*** MY_ECM active ***")
    
    target_include_directories(app PRIVATE
        # IP headers
        ${ZEPHYR_BASE}/subsys/net/ip
    )

    target_sources(app PRIVATE
        src/netusb/function_ecm.c
    )
endif()


if(CONFIG_USB_DEVICE_NETWORK_MY_NCM)
    message(STATUS "*** MY_NCM active ***")
    
    target_include_directories(app PRIVATE
        # IP headers
        ${ZEPHYR_BASE}/subsys/net/ip
    )

    target_sources(app PRIVATE
        src/netusb/function_ncm.c
    )
endif()


if(CONFIG_USB_DEVICE_NETWORK_MY_NCM_SIMPLE)
    message(STATUS "*** MY_NCM_SIMPLE active ***")
    
    target_include_directories(app PRIVATE
        # IP headers
        ${ZEPHYR_BASE}/subsys/net/ip
    )

    target_sources(app PRIVATE
        src/netusb/function_ncm_simple.c
    )
endif()


target_sources(app PRIVATE
    src/main.c
)


if (CONFIG_USB_DEVICE_STACK_NEXT)
  include(${ZEPHYR_BASE}/samples/subsys/usb/common/common.cmake)
endif()
```

## Kconfig
```
# zperf configuration options

# Copyright (c) 2017 Intel Corp.
# SPDX-License-Identifier: Apache-2.0


mainmenu "Your Application Name"

menu "My USB Device Networking support"

    config USB_DEVICE_NETWORK
        bool
        select NET_L2_ETHERNET
    
    config USB_DEVICE_NETWORK_MY_ECM
        bool "USB Ethernet Control Model (MY ECM) Networking device"
        select USB_DEVICE_NETWORK
        select USB_COMPOSITE_DEVICE
        help
            Ethernet Control Model (MY_ECM) is a part of  Communications Device
            Class (CDC) USB protocol specified by USB-IF.
    
    config USB_DEVICE_NETWORK_MY_NCM
        bool "USB Network Control Model (NCM) Networking device"
        select USB_DEVICE_NETWORK
        select USB_COMPOSITE_DEVICE
        help
            Network Control Model (NCM) is a part of  Communications Device
            Class (CDC) USB protocol specified by USB-IF.
    
    config USB_DEVICE_NETWORK_MY_NCM_SIMPLE
        bool "Simple USB Network Control Model (NCM) Networking device"
        select USB_DEVICE_NETWORK
        select USB_COMPOSITE_DEVICE
        help
            Simple Network Control Model (NCM) is a part of  Communications Device
            Class (CDC) USB protocol specified by USB-IF.
    
    
    # TODO CDC_ECM_INTERRUPT_EP_MPS etc have to be renamed
    if USB_DEVICE_NETWORK_MY_ECM  ||  USB_DEVICE_NETWORK_MY_NCM  ||  USB_DEVICE_NETWORK_MY_NCM_SIMPLE
    
        config CDC_ECM_INTERRUPT_EP_MPS
            int
            default 16
            help
                CDC ECM class interrupt endpoint size
        
        config CDC_ECM_BULK_EP_MPS
            int
            default 512 if USB_DC_HAS_HS_SUPPORT
            default 64
            help
                CDC ECM class bulk endpoint size
        
        config USB_DEVICE_NETWORK_ECM_MAC
            string "USB ECM Host OS MAC Address"
            default "00005E005301"
            help
                MAC Host OS Address string.
                MAC Address which would be assigned to network device, created in
                the Host's Operating System. Use RFC 7042 Documentation values as
                default MAC.
    
    endif # USB_DEVICE_NETWORK_MY_ECM  ||  USB_DEVICE_NETWORK_MY_NCM  ||  USB_DEVICE_NETWORK_MY_NCM_SIMPLE

    
    if USB_DEVICE_NETWORK_MY_NCM  ||  USB_DEVICE_NETWORK_MY_NCM_SIMPLE
    
        config CDC_NCM_XMT_NTB_MAX_SIZE
            int
            default 3200
            help
                Size of the NCM buffers for transmission (must be > MTU)
        
        config CDC_NCM_RCV_NTB_MAX_SIZE
            int
            default 3200
            help
                Size of the NCM buffers for reception (must be > MTU)
        
    endif # USB_DEVICE_NETWORK_MY_NCM  ||  USB_DEVICE_NETWORK_MY_NCM_SIMPLE
    
    
    if USB_DEVICE_NETWORK_MY_NCM
    
        config CDC_NCM_XMT_NTB_N
            int
            default 1
            help
                Number of NCM buffers for transmission

        config CDC_NCM_XMT_MAX_DATAGRAMS_PER_NTB
            int
            default 1
            help
                Number of datagrams in an NCM buffer to host

        
        config CDC_NCM_RCV_NTB_N
            int
            default 1
            help
                Number of NCM buffers for reception
        
        config CDC_NCM_RCV_MAX_DATAGRAMS_PER_NTB
            int
            default 1
            help
                Number of datagrams in an NCM buffer from host.  This setting
                depends on CONFIG_NET_PKT_RX_COUNT.
                Currently there is a problem within recv_transfer_datagram_to_netusb(), so use with care.

    endif # USB_DEVICE_NETWORK_MY_NCM


    if USB_DEVICE_NETWORK
        
        module = USB_DEVICE_NETWORK
        module-dep = LOG
        module-str = USB Device Network log level
        #source "subsys/net/Kconfig.template.log_config.net"
        
    endif # USB_DEVICE_NETWORK

endmenu # USB Device Networking support

source "Kconfig.zephyr"
source "samples/subsys/usb/common/Kconfig.sample_usbd"
```

## sample.yaml
```
common:
  tags:
    - net
    - zperf
  # TODO: Does not work properly with native_posix, need more TLC
  platform_exclude:
    - native_posix
    - native_posix_64
    - sam_e70_xplained
  min_ram: 64
sample:
  description: Network performance measurement tool for Zephyr
  name: zperf
tests:
  sample.net.zperf:
    harness: net
    platform_allow: qemu_x86
  sample.net.zperf_st:
    harness: console
    harness_config:
      type: multi_line
      regex:
        - "coming up"
    platform_allow:
      - nucleo_h563zi
      - nucleo_h743zi
      - nucleo_f429zi
      - nucleo_f746zg
      - stm32h573i_dk
  sample.net.zperf_no_shell:
    harness: net
    extra_configs:
      - CONFIG_NET_SHELL=n
    platform_allow: qemu_x86
  sample.net.zperf.netusb_ecm:
    harness: net
    extra_args: OVERLAY_CONFIG="overlay-netusb.conf"
    tags:
      - usb
      - net
      - zperf
    depends_on: usb_device
  sample.net.zperf.device_next_ecm:
    harness: net
    extra_args: OVERLAY_CONFIG="overlay-usbd_next.conf"
                DTC_OVERLAY_FILE="usbd_next_ecm.overlay"
    platform_allow: nrf52840dk_nrf52840 frdm_k64f
    tags: usb net zperf
    depends_on: usb_device
  sample.net.zperf.netusb_eem:
    harness: net
    extra_args: OVERLAY_CONFIG="overlay-netusb.conf"
    extra_configs:
      - CONFIG_USB_DEVICE_NETWORK_ECM=n
      - CONFIG_USB_DEVICE_NETWORK_EEM=y
    tags:
      - usb
      - net
      - zperf
    depends_on: usb_device
  sample.net.zperf.netusb_rndis:
    harness: net
    extra_args: OVERLAY_CONFIG="overlay-netusb.conf"
    extra_configs:
      - CONFIG_USB_DEVICE_NETWORK_ECM=n
      - CONFIG_USB_DEVICE_NETWORK_RNDIS=y
    tags:
      - usb
      - net
      - zperf
    depends_on: usb_device
  sample.net.zperf.shield:
    harness: net
    platform_allow: reel_board
    extra_args: SHIELD=link_board_eth
    tags:
      - shield
      - net
      - zperf
    depends_on:
      - arduino_spi
      - arduino_gpio
```

## prj.conf
```kconfig
CONFIG_NETWORKING=y
CONFIG_NET_ZPERF=y
#CONFIG_NET_LOG=y
CONFIG_NET_IPV6=y
CONFIG_NET_IPV4=y
#CONFIG_NET_DHCPV4=n
CONFIG_NET_UDP=y
CONFIG_NET_TCP=y
#CONFIG_NET_STATISTICS=y

CONFIG_NET_IF_UNICAST_IPV6_ADDR_COUNT=4
CONFIG_NET_IF_MCAST_IPV6_ADDR_COUNT=5
CONFIG_NET_IF_UNICAST_IPV4_ADDR_COUNT=4
CONFIG_NET_MAX_CONTEXTS=8
CONFIG_NET_TC_TX_COUNT=1
CONFIG_NET_SOCKETS=y
#CONFIG_NET_SOCKETS_POSIX_NAMES=y
CONFIG_NET_SOCKETS_POLL_MAX=15
CONFIG_POSIX_MAX_FDS=10

CONFIG_INIT_STACKS=y
CONFIG_TEST_RANDOM_GENERATOR=y

# required, otherwise there would be no network interface
CONFIG_NET_L2_ETHERNET=y

CONFIG_NET_CONFIG_SETTINGS=y
CONFIG_NET_CONFIG_MY_IPV6_ADDR="2001:db8::1"
CONFIG_NET_CONFIG_PEER_IPV6_ADDR="2001:db8::2"
CONFIG_NET_CONFIG_MY_IPV4_ADDR="192.168.2.1"
CONFIG_NET_CONFIG_PEER_IPV4_ADDR="192.168.2.2"

CONFIG_LOG=y
CONFIG_LOG_MODE_DEFERRED=n
#CONFIG_LOG_BUFFER_SIZE=48000

###########################################################
# my settings
#

CONFIG_LTO=n                     # currently no benefit
CONFIG_BUILD_OUTPUT_UF2=y

# RTT
CONFIG_UART_CONSOLE=n
CONFIG_RTT_CONSOLE=y
CONFIG_USE_SEGGER_RTT=y
CONFIG_SEGGER_RTT_BUFFER_SIZE_UP=8192

# SystemView
CONFIG_TRACING=y
#CONFIG_TRACING_ASYNC=y
CONFIG_TRACING_NETWORKING=n
CONFIG_TRACING_BACKEND_RAM=y
CONFIG_SEGGER_SYSTEMVIEW=y
CONFIG_SEGGER_SYSVIEW_POST_MORTEM_MODE=n
# CONFIG_SEGGER_SYSVIEW_RTT_BUFFER_SIZE: the bigger the better
CONFIG_SEGGER_SYSVIEW_RTT_BUFFER_SIZE=50000
CONFIG_SEGGER_SYSTEMVIEW_BOOT_ENABLE=y
CONFIG_SEGGER_SYSVIEW_RTT_CHANNEL=1
CONFIG_SEGGER_SYSVIEW_APP_NAME="zperf"
CONFIG_THREAD_NAME=y
CONFIG_SEGGER_RTT_MAX_NUM_DOWN_BUFFERS=2
CONFIG_SEGGER_RTT_MAX_NUM_UP_BUFFERS=3

# thread analyzer
CONFIG_THREAD_ANALYZER=n
CONFIG_THREAD_ANALYZER_AUTO=y
CONFIG_THREAD_ANALYZER_AUTO_INTERVAL=10

# shell available on NET
CONFIG_SHELL_CMDS=y
CONFIG_NET_SHELL=y
CONFIG_SHELL_CMDS_RESIZE=n
CONFIG_SHELL_BACKEND_TELNET=y
CONFIG_SHELL_HISTORY=y
CONFIG_SHELL_MINIMAL=n
CONFIG_SHELL_TAB=y
CONFIG_SHELL_TAB_AUTOCOMPLETION=y
CONFIG_SHELL_VT100_COLORS=y
CONFIG_SHELL_VT100_COMMANDS=y

# DHCP server
CONFIG_NET_DHCPV4_SERVER=n
##CONFIG_NET_DHCPV4_SERVER_LOG_LEVEL_DBG=y

# stack sizes
CONFIG_NET_TX_STACK_SIZE=6000
CONFIG_NET_RX_STACK_SIZE=6000
CONFIG_MAIN_STACK_SIZE=5900
CONFIG_NET_TCP_WORKQ_STACK_SIZE=6000
CONFIG_SYSTEM_WORKQUEUE_STACK_SIZE=6000

# zperf configuration
CONFIG_NET_ZPERF_MAX_PACKET_SIZE=4096
CONFIG_NET_ZPERF_LOG_LEVEL_DBG=y

#CONFIG_NET_L2_ETHERNET_LOG_LEVEL_DBG=y

CONFIG_NET_CONFIG_AUTO_INIT=n
```

## overlay-netusb.conf
```kconfig
CONFIG_USB_DEVICE_STACK=y
CONFIG_USB_DEVICE_INITIALIZE_AT_BOOT=n
CONFIG_USB_DEVICE_NETWORK_ECM=n
CONFIG_USB_DEVICE_NETWORK_EEM=n             # interface name is "usb0"
CONFIG_USB_DEVICE_NETWORK_RNDIS=n 
CONFIG_USB_DEVICE_NETWORK_MY_ECM=n
CONFIG_USB_DEVICE_NETWORK_MY_NCM=n
CONFIG_USB_DEVICE_NETWORK_MY_NCM_SIMPLE=y
CONFIG_USB_DEVICE_NETWORK_ECM_MAC="00005e005301"

CONFIG_NET_PKT_RX_COUNT=14
CONFIG_NET_PKT_TX_COUNT=14
CONFIG_NET_BUF_RX_COUNT=28
CONFIG_NET_BUF_TX_COUNT=28
CONFIG_NET_BUF_DATA_SIZE=1500

# not used by application stack sizes
CONFIG_USB_WORKQUEUE_STACK_SIZE=6000
CONFIG_USB_NRFX_WORK_QUEUE_STACK_SIZE=6000

CONFIG_LOG=y
CONFIG_UDC_DRIVER_LOG_LEVEL_WRN=y
CONFIG_USB_DEVICE_LOG_LEVEL_WRN=y
CONFIG_USB_DEVICE_NETWORK_LOG_LEVEL_WRN=y
```

## overlay-usbd_next.conf
```kconfig
CONFIG_USB_DEVICE_STACK_NEXT=y

# next-ncm does not work well with the static-size buffers
CONFIG_NET_PKT_BUF_RX_DATA_POOL_SIZE=10000
CONFIG_NET_PKT_BUF_TX_DATA_POOL_SIZE=10000
CONFIG_NET_BUF_VARIABLE_DATA_SIZE=y

# merker
#CONFIG_UDC_DRIVER=y
#CONFIG_UDC_NRF=y

# not used by application stack sizes
CONFIG_USBC_STACK_SIZE=6000
CONFIG_USBD_THREAD_STACK_SIZE=6000
CONFIG_USB_WORKQUEUE_STACK_SIZE=6000
CONFIG_USB_NRFX_WORK_QUEUE_STACK_SIZE=6000

CONFIG_LOG=y
CONFIG_USBD_LOG_LEVEL_WRN=y
CONFIG_UDC_DRIVER_LOG_LEVEL_WRN=y
CONFIG_USBD_CDC_NCM_LOG_LEVEL_WRN=y
CONFIG_USBD_CDC_ECM_LOG_LEVEL_WRN=y
```

## overlay-usbd_next_ecm.conf
```kconfig
CONFIG_USB_DEVICE_STACK_NEXT=y

# merker
#CONFIG_UDC_DRIVER=y
#CONFIG_UDC_NRF=y

#CONFIG_LOG=y
#CONFIG_USBD_LOG_LEVEL_DBG=y
#CONFIG_UDC_DRIVER_LOG_LEVEL_DBG=y
#CONFIG_NET_CONFIG_LOG_LEVEL_DBG=y
#CONFIG_USBD_CDC_ECM_LOG_LEVEL_DBG=y


CONFIG_LOG=y
CONFIG_USBD_LOG_LEVEL_WRN=y
CONFIG_UDC_DRIVER_LOG_LEVEL_WRN=y
```

## boards/nrf52840dk_nrf52840.conf
```kconfig
# Note: this file is not included automatically(?) and thus has to be specified via -DEXTRA_CONF_FILE=boards/$(BOARD).conf
```

## usbd_next_ecm.overlay
```dts
/*
 * Copyright (c) 2023 Nordic Semiconductor ASA
 *
 * SPDX-License-Identifier: Apache-2.0
 */

/ {
    cdc_ecm_eth0: cdc_ecm_eth0 {
        compatible = "zephyr,cdc-ecm-ethernet";
        remote-mac-address = "00005E005301";
    };
};
```

## usbd_next_ncm.overlay
```dts
/*
 * Copyright (c) 2023 Nordic Semiconductor ASA
 *
 * SPDX-License-Identifier: Apache-2.0
 */

/ {
    cdc_ncm_eth0: cdc_ncm_eth0 {
        compatible = "zephyr,cdc-ncm-ethernet";
        remote-mac-address = "00005E005301";
    };
};
```

## boards/nrf52840dk_nrf52840.overlay
```dts
/*
 * Copyright 2022 NXP
 *
 * SPDX-License-Identifier: Apache-2.0
 */

/* put here some board specifica, included automatically(?) if "-DBOARD_ROOT=." is specified */
```

## src/main.c
```c
/*
 * Copyright (c) 2020 Nordic Semiconductor ASA
 *
 * SPDX-License-Identifier: Apache-2.0
 */

/**
 * @file
 * @brief Zperf sample.
 */

/**
 * Host setup etc
 * ==============
 *
 * sudo systemctl restart networking.service
 * sudo ip addr add 2001:db8::2/64 dev enx00005e005301
 *
 *
 * /etc/network/interfaces
 * -----------------------
 *   allow-hotplug enx00005e005301
 *   iface enx00005e005301 inet static
 *       address 192.168.2.2
 *       netmask 255.255.255.0
 *   iface enx00005e005301 inet6 static
 *       address 2001:db8::2
 *       netmask 64
 *
 * DHCPv4 server sets unfortunately the default route?
 *
 *
 * Testing
 * -------
 * iperf IPv6:
 *     - for MSS in 10 100 800 1450; do iperf -c 2001:db8::1 -e -i 1 -M $MSS -l 8192 -P 1; sleep 2; done
 *     - for MSS in 10 20 40 80 160 320 640 1000 1100 1200 1300 1400 1500; do iperf -c 2001:db8::1 -e -i 1 -M $MSS -l 8192 -P 1; sleep 2; done
 *
 * iperf UDP does only work with IPv4!
 *     - iperf -c 192.168.2.1 -e -i 1 -M 1000 -l 8192 -P 1 -u
 *     - iperf -c 192.168.2.1 -e -i 1 -l 1024 -P 1 -u
 *          loads SystemView fully
 *     - for MSS in 10 20 40 80 160 320 640 1000 1100 1200 1300 1400 1500; do iperf -c 192.168.2.1 -e -i 1 -M $MSS -l 8192 -P 1 -u; sleep 2; done
 *
 * Other tests:
 *     - iperf -c 192.168.2.1 -e -i 1 -M 8000 -l 125 -P 1 -b 1000
 *     - for MSS in {100..512}; do iperf -c 192.168.2.1 -e -i 1 -M $MSS -l 8192 -P 1; sleep 2; done
 *     - ping -f 192.168.2.1 -i 0.006
 *          this works nice with SystemView (almost max load)
 *
 * Telnet:
 *     - telnet 2001:db8::1
 *
 * SystemView tracing:
 *     - cp $ZEPHYR_BASE/subsys/tracing/sysview/SYSVIEW_Zephyr.txt /opt/SEGGER/SystemView_V352a/Description
 *
 *     - this did not work:
 *         cp $ZEPHYR_BASE/subsys/tracing/sysview/SYSVIEW_Zephyr.txt ~/.config/SEGGER/
 *
 * Notes
 * -----
 * - 25.07.2024
 *   - only zperf-UDP does currently work
 *   - switched network logging off, because that crashed the application
 */

#include <zephyr/logging/log.h>
#include <zephyr/net/dhcpv4_server.h>
#include <zephyr/net/net_config.h>
#include <zephyr/net/zperf.h>
#include <zephyr/usb/usb_device.h>
#include <zephyr/usb/usbd.h>

#ifdef CONFIG_NET_LOOPBACK_SIMULATE_PACKET_DROP
    #include <zephyr/net/loopback.h>
#endif

#if defined(CONFIG_USB_DEVICE_STACK_NEXT)
    #include <sample_usbd.h>
#endif


LOG_MODULE_REGISTER(zperf, LOG_LEVEL_DBG);


#define DHCPV4_POOL_START "192.168.2.20"



#if defined(CONFIG_USB_DEVICE_STACK_NEXT)
static int enable_usb_device_next(void)
{
    struct usbd_contex *sample_usbd = sample_usbd_init_device(NULL);

    if (sample_usbd == NULL) {
        printk("Failed to initialize USB device");
        return -ENODEV;
    }

    return usbd_enable(sample_usbd);
}
#endif /* CONFIG_USB_DEVICE_STACK_NEXT */



void my_zperf_callback(enum zperf_status status,
                       struct zperf_results *result,
                       void *user_data)
/**
 * Print out some statistics.
 *
 * \note
 *    works only with TCP
 */
{
    if (status == ZPERF_SESSION_STARTED)
    {
        LOG_INF("------------------------------------------------");
        LOG_INF("zperf session started...");
    }
    else if (status == ZPERF_SESSION_FINISHED)
    {
        LOG_INF("...finished");

        if (result != NULL)
        {
#if 0
            printk("total:                  %d bytes\n", (int)result->total_len);
            printk("packet_size:            %d\n", result->packet_size);
            printk("duration:               %dms\n", (int)(result->time_in_us / 1000));
            printk("jitter_in_us:           %dus\n", result->jitter_in_us);
            printk("client_time_in_us:      %dus\n", (int)result->client_time_in_us);

            printk("nb_packets_sent:        %d\n", result->nb_packets_sent);
            printk("nb_packets_rcvd:        %d\n", result->nb_packets_rcvd);
            printk("nb_packets_lost:        %d\n", result->nb_packets_lost);
            printk("nb_packets_outorder:    %d\n", result->nb_packets_outorder);
            printk("nb_packets_errors:      %d\n", result->nb_packets_errors);
#else
            LOG_INF("total:                  %d bytes", (int)result->total_len);
            LOG_INF("duration:               %dms", (int)(result->time_in_us / 1000));
            LOG_INF("throughput:             %d bytes/s", (int)((100*result->total_len) / (result->time_in_us / 10000)));
            LOG_INF("                        %d bit/s", (int)((100*result->total_len) / (result->time_in_us / 80000)));
#endif
        }
        LOG_INF("================================================");
    }
    else
    {
        LOG_ERR("zperf error: %d\n", status);
    }
}   // zperf_callback



#if CONFIG_NET_DHCPV4_SERVER
static void configure_dhcp_server(void)
/**
 * Start DHCPv4 server
 *
 * TODO it seems that the stack is too small
 */
{
    struct net_if *iface;
    struct in_addr pool_start;
    int ret;

    iface = net_if_get_first_up();
    if ( !iface)
    {
        LOG_ERR("Failed to get network interface");
        return;
    }

    if (net_addr_pton(AF_INET, DHCPV4_POOL_START, &pool_start.s_addr))
    {
        LOG_ERR("Invalid address: %s", DHCPV4_POOL_START);
        return;
    }

    ret = net_dhcpv4_server_start(iface, &pool_start);
    if (ret == -EALREADY)
    {
        LOG_ERR("DHCPv4 server already running on interface");
    }
    else if (ret < 0)
    {
        LOG_ERR("DHCPv4 server failed to start and returned %d error", ret);
    }
    else
    {
        LOG_INF("DHCPv4 server started and pool address starts from %s", DHCPV4_POOL_START);
    }
}   // configure_dhcp_server
#endif



int main(void)
{
#if defined(CONFIG_USB_DEVICE_STACK) || defined(CONFIG_USB_DEVICE_STACK_NEXT)
    int ret;

#if defined(CONFIG_USB_DEVICE_STACK)
    ret = usb_enable(NULL);
#endif
#if defined(CONFIG_USB_DEVICE_STACK_NEXT)
    ret = enable_usb_device_next();
#endif
    if (ret != 0) {
        printk("usb enable error %d\n", ret);
    }

    (void)net_config_init_app(NULL, "Initializing network");
#endif /* CONFIG_USB_DEVICE_STACK */

#ifdef CONFIG_NET_LOOPBACK_SIMULATE_PACKET_DROP
    loopback_set_packet_drop_ratio(1);
#endif

    //
    // automatically start TCP/UDP server
    //
    k_msleep(500);
    {
        static const struct zperf_download_params param = { .port = 5001 };

        zperf_tcp_download( &param, my_zperf_callback, NULL);
        zperf_udp_download( &param, my_zperf_callback, NULL);   // just with IPv4?  And no callback?
    }

    return 0;
}
```
